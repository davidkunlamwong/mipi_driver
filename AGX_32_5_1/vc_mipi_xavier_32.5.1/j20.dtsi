/*
 * J20 device tree - 2019
 */

// #include <dt-bindings/media/camera.h>
// #include <dt-bindings/platform/t210/t210.h>

//#include "dt-bindings/clock/tegra186-clock.h"
//
//#define CAM0_RST_L  TEGRA_MAIN_GPIO(R, 5)
//#define CAM0_PWDN   TEGRA_MAIN_GPIO(R, 0)

/*
I2C Busses:

i2c0 = "/i2c@3160000";
i2c1 = "/i2c@c240000";
i2c2 = "/i2c@3180000";
i2c3 = "/i2c@3190000";
i2c4 = "/i2c@31a0000";
i2c5 = "/i2c@31b0000";
i2c6 = "/i2c@31c0000";
i2c7 = "/i2c@c250000";
i2c8 = "/i2c@31e0000";
*/

/ {
    i2c@3180000 {
        j20_6@20 {
            compatible = "nvidia,j20";
            /* I2C device address */
            reg = <0x20>;
            status = "okay";
//            reset-gpios = <&tegra_main_gpio CAM0_PWDN GPIO_ACTIVE_HIGH>;
     };
  };

};
